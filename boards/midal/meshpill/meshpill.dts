/*
 * Copyright (c) 2022-2023 Marcin Niestroj
 *
 * SPDX-License-Identifier: Apache-2.0
 */

/dts-v1/;
#include "meshpill_common.dtsi"

/ {
	model = "Midal MESHPILL";
	compatible = "midal,meshpill";
};

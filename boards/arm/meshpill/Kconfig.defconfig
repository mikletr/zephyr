## boards/arm/meshpill/Kconfig.defconfig
```kconfig
# Copyright (c) 2024 Nordic Semiconductor ASA
# SPDX-License-Identifier: Apache-2.0

if BOARD_MESHPILL

config BOARD
	default "meshpill"

config BT_CTLR
   default BT


endif
```

## boards/midal/meshpill/Kconfig.meshpill
```kconfig
# MESHPILL board configuration

# Copyright (c) 2022 Marcin Niestroj
# SPDX-License-Identifier: Apache-2.0

config BOARD_MESHPILL
	select SOC_NRF52840_QIAA
```

## boards/midal/meshpill/board.yml
```yaml
board:
  name: meshpill
  full_name: MESHPILL (Sense)
  vendor: midal
  socs:
  - name: nrf52840
    variants:
    - name: 'sense'
```
